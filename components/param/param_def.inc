#include "user_param.h"

NORMAL_PARAM_BEGIN
    NORMAL_PARAM_ITEM(VOLUME_LEVEL, PARAM_TYPE_INT, "volume", {.valInt = 5})
    NORMAL_PARAM_ITEM(LCD_LEVEL, PARAM_TYPE_DOUBLE, "level", {.valDouble = 50})
    NORMAL_PARAM_ITEM(DEV_NAME, PARAM_TYPE_STRING, "devName", {.valString = "keystone"})
    NORMAL_PARAM_ITEM(TOUCH_REVERSE_X, PARAM_TYPE_INT, "touchReverseX", {.valInt = 0})
    NORMAL_PARAM_ITEM(TOUCH_REVERSE_Y, PARAM_TYPE_INT, "touchReverseY", {.valInt = 0})
NORMAL_PARAM_END

PROTECTED_PARAM_BEGIN
    PROTECTED_PARAM_ITEM(DEV_SN, PARAM_TYPE_STRING, "devSn", {.valString = "keystone_1234"})
    PROTECTED_PARAM_ITEM(DEV_SECRET_KEY, PARAM_TYPE_STRING, "secretKey", {.valString = "ASDFGHJKL"})
PROTECTED_PARAM_END

